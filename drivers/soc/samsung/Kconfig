## drivers/soc/samsung/Kconfig
```kconfig
#
# SAMSUNG SoC drivers
#
menuconfig SOC_SAMSUNG
	bool "Samsung SoC driver support" if COMPILE_TEST

if SOC_SAMSUNG

config EXYNOS_PMU
	bool "Exynos PMU controller driver" if COMPILE_TEST
	depends on (ARM && ARCH_EXYNOS) || ((ARM || ARM64) && COMPILE_TEST)

config EXYNOS_PM_DOMAINS
	bool "Exynos PM domains" if COMPILE_TEST
	depends on PM_GENERIC_DOMAINS || COMPILE_TEST

endif

config DRV_SAMSUNG
	bool "samsung device dedicated drivers option"
	default y
	help
	  This is driver option for samsung sec_class
	  Say y here to enable samsung classes for drivers
	  Provide option of enabling sec class
	  Supports sec drivers key, touch, sec_debug etc

config SEC_INCELL
	bool "Incell data & function for Samsung"
	default n
	help
	  say y to enable incell data & function for Samsung.
```
